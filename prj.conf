## CMakeLists.txt
```
#
# Copyright (c) 2020 Nordic Semiconductor
#
# SPDX-License-Identifier: LicenseRef-Nordic-5-Clause
#

cmake_minimum_required(VERSION 3.20.0)

set(DTC_OVERLAY_FILE nrf9160dk_nrf9160ns.overlay)
find_package(Zephyr REQUIRED HINTS $ENV{ZEPHYR_BASE})
project(udp)

# NORDIC SDK APP START
target_sources(app PRIVATE src/udp.c)
target_sources(app PRIVATE src/uart.c)
target_sources(app PRIVATE src/UART_handler.c)
# NORDIC SDK APP END

zephyr_include_directories(src)
```

## Kconfig
```
#
# Copyright (c) 2020 Nordic Semiconductor ASA
#
# SPDX-License-Identifier: LicenseRef-Nordic-5-Clause
#

menu "UDP Sample Settings"

config UDP_DATA_UPLOAD_SIZE_BYTES
	int "Number of bytes transmitted to the server"
	default 10

config UDP_DATA_UPLOAD_FREQUENCY_SECONDS
	int "How often data is transmitted to the server"
	default 30

config UDP_SERVER_ADDRESS_STATIC
	string "UDP server IP address"
	default "8.8.8.8"

config UDP_SERVER_PORT
	int "UDP server port number"
	default "2469"

config UDP_PSM_ENABLE
	bool "Enable LTE Power Saving Mode"
	default y

config UDP_EDRX_ENABLE
	bool "Enable LTE enhanced Discontinuous Reception"

config UDP_RAI_ENABLE
	bool "Enable LTE Release Assistance Indication"

endmenu

module = UDP
module-str = UDP sample
source "${ZEPHYR_BASE}/subsys/logging/Kconfig.template.log_config"

menu "Zephyr Kernel"
source "Kconfig.zephyr"
endmenu
```

## prj.conf
```kconfig
#
# Copyright (c) 2020 Nordic Semiconductor ASA
#
# SPDX-License-Identifier: LicenseRef-Nordic-5-Clause
#

# General config
CONFIG_NEWLIB_LIBC=y
CONFIG_NEWLIB_LIBC_FLOAT_PRINTF=y
#CONFIG_NCS_SAMPLES_DEFAULTS=y
CONFIG_SERIAL=n

# Network
CONFIG_NETWORKING=y
CONFIG_NET_NATIVE=n
CONFIG_NET_SOCKETS=y
CONFIG_NET_SOCKETS_OFFLOAD=y

# LTE link control
CONFIG_LTE_LINK_CONTROL=y
CONFIG_LTE_AUTO_INIT_AND_CONNECT=n

# Modem library
CONFIG_NRF_MODEM_LIB=y

# Heap and stacks
CONFIG_HEAP_MEM_POOL_SIZE=1024
CONFIG_MAIN_STACK_SIZE=4096
CONFIG_SYSTEM_WORKQUEUE_STACK_SIZE=2048

# LTE parameters
## Network Mode / LTE category
CONFIG_LTE_NETWORK_MODE_LTE_M=y

## PSM
CONFIG_UDP_PSM_ENABLE=y
CONFIG_LTE_PSM_REQ_RPTAU="00100001"
CONFIG_LTE_PSM_REQ_RAT="00000000"

## eDRX
CONFIG_UDP_EDRX_ENABLE=n
CONFIG_LTE_EDRX_REQ_VALUE_LTE_M="1001"

## RAI
CONFIG_UDP_RAI_ENABLE=n
CONFIG_LTE_RAI_REQ_VALUE="4"



####################kurosh############################
CONFIG_PRINTK=y
CONFIG_UART_0_NRF_TX_BUFFER_SIZE=256

# for RTT
CONFIG_SERIAL=y
CONFIG_UART_INTERRUPT_DRIVEN=y
CONFIG_RTT_CONSOLE=y
CONFIG_USE_SEGGER_RTT=y
CONFIG_STDOUT_CONSOLE=y
CONFIG_UART_CONSOLE=n


# MODEM INFO AND JSON LIBRARY
CONFIG_MODEM_INFO=y
CONFIG_CJSON_LIB=y

#Number of bytes transmitted to the server
CONFIG_UDP_DATA_UPLOAD_SIZE_BYTES=500
#How often data is transmitted to the server
CONFIG_UDP_DATA_UPLOAD_FREQUENCY_SECONDS=12
#UDP server IP address
CONFIG_UDP_SERVER_ADDRESS_STATIC="212.227.175.162"
#UDP server port number
CONFIG_UDP_SERVER_PORT=8890

# LTE parameters
## Network Mode / LTE category
# CONFIG_LTE_NETWORK_MODE_LTE_M=y
CONFIG_LTE_NETWORK_MODE_NBIOT=y
CONFIG_LTE_LOCK_BANDS=y
#Band 3,8,20
#CONFIG_LTE_LOCK_BAND_MASK="10000000000010000100"
#Band 3,8
#CONFIG_LTE_LOCK_BAND_MASK="00000000000010000100"
#Band 8,20
#CONFIG_LTE_LOCK_BAND_MASK="10000000000010000000"
#Band 3
#CONFIG_LTE_LOCK_BAND_MASK="00000000000000000100"
#Band 8
CONFIG_LTE_LOCK_BAND_MASK="00000000000010000000"
#Band 20
# CONFIG_LTE_LOCK_BAND_MASK="10000000000000000000"

# Heap and stacks
CONFIG_MAIN_STACK_SIZE=4096
CONFIG_HEAP_MEM_POOL_SIZE=16384
CONFIG_SYSTEM_WORKQUEUE_STACK_SIZE=8192
CONFIG_NRF_MODEM_LIB_HEAP_SIZE=2048
CONFIG_NRF_MODEM_LIB_SHMEM_RX_SIZE=16384
# CONFIG_MINIMAL_LIBC_MALLOC_ARENA_SIZE=2048

CONFIG_CBOR_FLOATING_POINT=y


CONFIG_LOG=y
CONFIG_WDT_LOG_LEVEL_DBG=y
CONFIG_NET_CONFIG_LOG_LEVEL_DBG=y
CONFIG_LTE_LINK_CONTROL_LOG_LEVEL_DBG=y
CONFIG_NET_SOCKETS_LOG_LEVEL_DBG=y
```

## nrf9160dk_nrf9160ns.overlay
```dts
/*
 * Copyright (c) 2020, Nordic Semiconductor ASA
 *
 * SPDX-License-Identifier: Apache-2.0
 */

// &uart0 {
// 	status = "okay";
// 	current-speed = <115200>;
// 	tx-pin = < 0xf >; //15
// 	rx-pin = < 0x10 >; //16
// 	rts-pin = < 0xd >; //13
// 	cts-pin = < 0xe >; //14
// };

// &uart1 {
// 	status = "okay";
// 	current-speed = <115200>;
// 	tx-pin = < 0x1d >; //29
// 	rx-pin = < 0x1c >; //28
// 	rts-pin = < 0x1b >; //27
// 	cts-pin = < 0x1a >; //26
// };
&uart0 {
	status = "okay";
	compatible = "nordic,nrf-uarte";
	current-speed = <115200>;
	// draeger module (new):
	tx-pin = <13>;
	rx-pin = <14>;
	rts-pin = <16>;
	cts-pin = <17>;
};
&uart1 {
	status = "okay";
	compatible = "nordic,nrf-uarte";
	current-speed = <115200>;
	// draeger module (new):
	tx-pin = <30>;
	rx-pin = <28>;
	rts-pin = <2>;
	cts-pin = <3>;
};
```

## src/UART_handler.c
```c
/*
Author: Björn Sievers
Project: UART_handler
Purpose: Enables easier integration of UART message handling in the desired project.
This project uses ISR & the Zephyr OS FIFO feature to store & send messages from a desired UART port
This handler has the feature to listen for specific "endMarkers" which are expected as an indicator of the end of a UART message.
The endMarkers to be listend to can be specified in the "UART_handler.h" file.
IMPORTANT: If the endMarker does not appear in the received UART string the received message will not be made stored into the FIFO structure!
*/

//++++++++++++++++++++++++++ INCLUDES START +++++++++++++++++++++++++++
#include <zephyr.h>
#include <kernel.h>
#include <sys/printk.h>
#include <sys/__assert.h>
#include <device.h>
#include <devicetree.h>
#include <string.h>
#include <drivers/uart.h>
#include <stdio.h>
#include "UART_handler.h"
//++++++++++++++++++++++++++ INCLUDES END +++++++++++++++++++++++++++

static K_FIFO_DEFINE(fifo_uart_tx_data);
static K_FIFO_DEFINE(fifo_uart1_tx_data);

static K_FIFO_DEFINE(fifo_uart_rx_data);
static K_FIFO_DEFINE(fifo_uart1_rx_data);

uart_rx_helper uart0_rx = { 0, { 0 }, false };
uart_rx_helper uart1_rx = { 0, { 0 }, false };

const struct device *uart_dev_0;
const struct device *uart_dev_1;

static void rx_isr_uart_0(const struct device *x)
{
	int data_length = 0;
	uint8_t byte;
	data_length = uart_fifo_read(x, &byte, 1);
	if (uart0_rx.uart_rx_buff_len < UART_RX_LINE_BUF_SIZE) {
		uart0_rx.uart_rx_buf[uart0_rx.uart_rx_buff_len] = byte;
		uart0_rx.uart_rx_buff_len += data_length;
	}
	//If received byte stream exceeds maximum buffer size of UART_RX_LINE_BUF_SIZE
	//remaining incomming data will be ignored and the already received data stream will be
	//treated as invalid data which will be tossed away as soon as an EndMarker was found.
	else {
		uart0_rx.dirty = true;
		uart0_rx.uart_rx_buff_len += data_length;
	}
	// printk("byte: %d\n", (uint8_t)byte);

	// if (byte == COM_RX_ENDMARKER_1_UART0 ||
	//     byte == COM_RX_ENDMARKER_2_UART0) {
	if ((byte == 50) && (uart0_rx.uart_rx_buff_len - 9 >= 0)) {
		printk("cond: %d \n",
		       ((uart0_rx.uart_rx_buf[uart0_rx.uart_rx_buff_len - 2] ==
			 48) &&
			(uart0_rx.uart_rx_buf[uart0_rx.uart_rx_buff_len - 3] ==
			 49) &&
			(uart0_rx.uart_rx_buf[uart0_rx.uart_rx_buff_len - 4] ==
			 104) &&
			(uart0_rx.uart_rx_buf[uart0_rx.uart_rx_buff_len - 5] ==
			 115) &&
			(uart0_rx.uart_rx_buf[uart0_rx.uart_rx_buff_len - 6] ==
			 105) &&
			(uart0_rx.uart_rx_buf[uart0_rx.uart_rx_buff_len - 7] ==
			 110) &&
			(uart0_rx.uart_rx_buf[uart0_rx.uart_rx_buff_len - 8] ==
			 105) &&
			(uart0_rx.uart_rx_buf[uart0_rx.uart_rx_buff_len - 9] ==
			 102)) ?
				     1 :
				     0);
		if ((uart0_rx.uart_rx_buf[uart0_rx.uart_rx_buff_len - 2] ==
		     48) &&
		    (uart0_rx.uart_rx_buf[uart0_rx.uart_rx_buff_len - 3] ==
		     49) &&
		    (uart0_rx.uart_rx_buf[uart0_rx.uart_rx_buff_len - 4] ==
		     104) &&
		    (uart0_rx.uart_rx_buf[uart0_rx.uart_rx_buff_len - 5] ==
		     115) &&
		    (uart0_rx.uart_rx_buf[uart0_rx.uart_rx_buff_len - 6] ==
		     105) &&
		    (uart0_rx.uart_rx_buf[uart0_rx.uart_rx_buff_len - 7] ==
		     110) &&
		    (uart0_rx.uart_rx_buf[uart0_rx.uart_rx_buff_len - 8] ==
		     105) &&
		    (uart0_rx.uart_rx_buf[uart0_rx.uart_rx_buff_len - 9] ==
		     102)) {
			if (!uart0_rx.dirty) {
				uart_rx_fifo_data_t *rx_data =
					k_malloc(sizeof(uart_rx_fifo_data_t));
				if (rx_data) {
					rx_data->received_line =
						k_malloc(UART_RX_LINE_BUF_SIZE);
					if (rx_data->received_line) {
						memcpy(rx_data->received_line,
						       uart0_rx.uart_rx_buf,
						       uart0_rx.uart_rx_buff_len);
						rx_data->len =
							uart0_rx.uart_rx_buff_len;
						rx_data->received_line
							[rx_data->len] = '\0';
						k_fifo_put(&fifo_uart_rx_data,
							   rx_data);
						memset(uart0_rx.uart_rx_buf, 0,
						       UART_RX_LINE_BUF_SIZE);
						uart0_rx.uart_rx_buff_len = 0;
						uart0_rx.dirty = false;
					}
				}
			} else {
				printk("UART0: Received data stream exceeds buffer size! Len: %d\n",
				       uart0_rx.uart_rx_buff_len);
				memset(uart0_rx.uart_rx_buf, 0,
				       UART_RX_LINE_BUF_SIZE);
				uart0_rx.uart_rx_buff_len = 0;
				uart0_rx.dirty = false;
			}
		}
	}
}

static void rx_isr_uart_1(const struct device *x)
{
	int data_length = 0;
	uint8_t byte;
	data_length = uart_fifo_read(x, &byte, 1);
	if (uart1_rx.uart_rx_buff_len < UART_RX_LINE_BUF_SIZE) {
		uart1_rx.uart_rx_buf[uart1_rx.uart_rx_buff_len] = byte;
		uart1_rx.uart_rx_buff_len += data_length;
	}
	//If received byte stream exceeds maximum buffer size of UART_RX_LINE_BUF_SIZE
	//remaining incomming data will be ignored and the already received data stream will be
	//treated as invalid data which will be tossed away as soon as an EndMarker was found.
	else {
		uart1_rx.dirty = true;
		uart1_rx.uart_rx_buff_len += data_length;
	}
	//printk("Byte: %c\n", (char*)byte);
	if (byte == COM_RX_ENDMARKER_1_UART1 ||
	    byte == COM_RX_ENDMARKER_2_UART1) {
		if (!uart1_rx.dirty) {
			uart_rx_fifo_data_t *rx_data =
				k_malloc(sizeof(uart_rx_fifo_data_t));
			if (rx_data) {
				rx_data->received_line =
					k_malloc(UART_RX_LINE_BUF_SIZE);
				if (rx_data->received_line) {
					memcpy(rx_data->received_line,
					       uart1_rx.uart_rx_buf,
					       uart1_rx.uart_rx_buff_len);
					//printk("Received before FIFO: %s\n", rx_data->received_line);
					rx_data->len =
						uart1_rx.uart_rx_buff_len;
					rx_data->received_line[rx_data->len] =
						'\0';
					k_fifo_put(&fifo_uart1_rx_data,
						   rx_data);
					memset(uart1_rx.uart_rx_buf, 0,
					       UART_RX_LINE_BUF_SIZE);
					uart1_rx.uart_rx_buff_len = 0;
					uart1_rx.dirty = false;
				}
			}
		} else {
			printk("UART1: Received data stream exceeds buffer size! Len: %d\n",
			       uart1_rx.uart_rx_buff_len);
			memset(uart1_rx.uart_rx_buf, 0, UART_RX_LINE_BUF_SIZE);
			uart1_rx.uart_rx_buff_len = 0;
			uart1_rx.dirty = false;
		}
	}
}

static void tx_isr_uart_0(const struct device *x)
{
	static uart_data_t *buf = NULL;
	if (!buf) {
		buf = k_fifo_get(&fifo_uart_tx_data, K_NO_WAIT);
		//Check if there is data in the FIFO and if so does it comply with specified max. message length.
		if (buf) {
			if (buf->len > UART_TX_LINE_BUF_SIZE) {
				uart_irq_tx_disable(x);
				buf = NULL;
				printk("UART0: Received data string exceeds maximum specified buffer length: Max.: %d",
				       UART_TX_LINE_BUF_SIZE);
				return;
			}

			uint16_t written = 0;
			while (buf->len > written) {
				written +=
					uart_fifo_fill(x, &buf->data[written],
						       buf->len - written);
				printk("Written: %d, Send: %s", written,
				       buf->data);
			}
			while (!uart_irq_tx_complete(x)) {
				/* Wait for the last byte to get
		 	* shifted out of the module
			*/
			}
			if (k_fifo_is_empty(&fifo_uart_tx_data)) {
				memset(buf->data, 0, sizeof(buf->data));
				if (buf != NULL) {
					k_free(buf);
				}
				buf = NULL;
				uart_irq_tx_disable(x);
			}
		}
		/* Nothing in the FIFO, nothing to send or received databuffer exceeds maximum length*/
		else {
			uart_irq_tx_disable(x);
			return;
		}
		if (buf != NULL) {
			buf = NULL;
		}
	}
}

static void tx_isr_uart_1(const struct device *x)
{
	uart_data_t *buf2 = NULL;
	if (!buf2) {
		buf2 = k_fifo_get(&fifo_uart1_tx_data, K_NO_WAIT);
		//Check if there is data in the FIFO and if so does it comply with specified max. message length.
		if (buf2) {
			if (buf2->len > UART_TX_LINE_BUF_SIZE) {
				uart_irq_tx_disable(x);
				buf2 = NULL;
				printk("UART1: Received data string exceeds maximum specified buffer length: Max.: %d",
				       UART_TX_LINE_BUF_SIZE);
				return;
			}

			uint16_t written = 0;
			//printk("+++++++++++++++++++++SENDING: %s", buf2->data);
			while (buf2->len > written) {
				written +=
					uart_fifo_fill(x, &buf2->data[written],
						       buf2->len - written);
				//printk("Written: %d, Send: %s", written, buf->data);
			}
			while (!uart_irq_tx_complete(x)) {
				/* Wait for the last byte to get
		 	* shifted out of the module
			*/
			}
			if (k_fifo_is_empty(&fifo_uart1_tx_data)) {
				memset(buf2->data, 0, sizeof(buf2->data));
				if (buf2 != NULL) {
					k_free(buf2);
				}
				buf2 = NULL;
				uart_irq_tx_disable(x);
			}
		}
		/* Nothing in the FIFO, nothing to send or received databuffer exceeds maximum length*/
		else {
			uart_irq_tx_disable(x);
			return;
		}
		if (buf2 != NULL) {
			buf2 = NULL;
		}
	}
}

static void uart_cb(const struct device *x, void *user_data)
{
	uart_irq_update(x);

	//RX_HANDLING
	if (uart_irq_rx_ready(x)) {
		if (x == uart_dev_0) {
			rx_isr_uart_0(x);
		}
		if (x == uart_dev_1) {
			rx_isr_uart_1(x);
		}
	}

	//TX_HANDLING
	if (uart_irq_tx_ready(x)) {
		if (x == uart_dev_0) {
			tx_isr_uart_0(x);
		}
		if (x == uart_dev_1) {
			tx_isr_uart_1(x);
		}
	}
}

int tx_message_uart(char *tx_buf, size_t msg_len, const struct device *x)
{
	if (tx_buf == NULL || msg_len < 0) {
		return -EINVAL;
	}
	if ((msg_len > CONFIG_UART_0_NRF_TX_BUFFER_SIZE) && (x == uart_dev_0)) {
		return -EFBIG;
	}
	if ((msg_len > CONFIG_UART_1_NRF_TX_BUFFER_SIZE) && (x == uart_dev_1)) {
		return -EFBIG;
	}

	uart_data_t *tx_data = k_malloc(sizeof(uart_data_t));
	if (tx_data == NULL) {
		printk("NO MEMORY ALLOCATED!!!!!!!\n");
		return -EINVAL;
	}
	tx_data->len = msg_len;
	memcpy(tx_data->data, tx_buf, msg_len);

	if (x == uart_dev_0) {
		k_fifo_put(&fifo_uart_tx_data, tx_data);
		//k_free(tx_data);
		uart_irq_tx_enable(x);
		return 0;
	}
	if (x == uart_dev_1) {
		k_fifo_put(&fifo_uart1_tx_data, tx_data);
		//k_free(tx_data);
		uart_irq_tx_enable(x);
		return 0;
	} else
		k_free(tx_data);
	return -EINVAL;
}

int rx_message_uart(uint8_t *rx_buf, k_timeout_t timeout,
		    const struct device *x)
{
	if (rx_buf == NULL) {
		return -EINVAL;
	}

	int len = 0;
	uart_rx_fifo_data_t *received = NULL;
	if (x == uart_dev_0) {
		received = k_fifo_get(&fifo_uart_rx_data, timeout);
	}
	if (x == uart_dev_1) {
		received = k_fifo_get(&fifo_uart1_rx_data, timeout);
	}
	if (received) {
		memcpy(rx_buf, received->received_line, received->len);
		len = received->len;
		k_free(received->received_line);
		k_free(received);
	} else {
		return -EINVAL;
	}
	return len;
}

const struct device *init_uart_dev(const char *uart_num)
{
	if (uart_num == NULL) {
		return NULL;
	}
	int comp = strcmp(uart_num, "UART_0");
	if (comp == 0) {
		uart_dev_0 = device_get_binding(uart_num);
		if (!uart_dev_0) {
			printk("[UART] Failed to get device!\n");
			return NULL;
		}
		// and initialise
		uart_irq_rx_disable(uart_dev_0);
		uart_irq_tx_disable(uart_dev_0);
		uart_irq_callback_set(uart_dev_0, uart_cb);
		return uart_dev_0;
	}
	comp = strcmp(uart_num, "UART_1");
	if (comp == 0) {
		uart_dev_1 = device_get_binding(uart_num);
		if (!uart_dev_1) {
			printk("[UART] Failed to get device!\n");
			return NULL;
		}
		// and initialise
		uart_irq_rx_disable(uart_dev_1);
		uart_irq_tx_disable(uart_dev_1);
		uart_irq_callback_set(uart_dev_1, uart_cb);
		return uart_dev_1;
	}
	return NULL;
}

const struct device *init_uart_dev_and_ISR(const char *uart_num)
{
	if (uart_num == NULL) {
		return NULL;
	}

	int comp = strcmp(uart_num, "UART_0");
	if (comp == 0) {
		uart_dev_0 = device_get_binding(uart_num);
		if (!uart_dev_0) {
			printk("[UART] Failed to get device!\n");
			return NULL;
		}
		// and initialise
		uart_irq_rx_disable(uart_dev_0);
		uart_irq_tx_disable(uart_dev_0);
		uart_irq_callback_set(uart_dev_0, uart_cb);
		uart_irq_rx_enable(uart_dev_0);
		return uart_dev_0;
	}
	comp = strcmp(uart_num, "UART_1");
	if (comp == 0) {
		uart_dev_1 = device_get_binding(uart_num);
		if (!uart_dev_1) {
			printk("[UART] Failed to get device!\n");
			return NULL;
		}
		// and initialise
		uart_irq_rx_disable(uart_dev_1);
		uart_irq_tx_disable(uart_dev_1);
		uart_irq_callback_set(uart_dev_1, uart_cb);
		uart_irq_rx_enable(uart_dev_1);
		return uart_dev_1;
	}
	return NULL;
}
```

## src/UART_handler.h
```c
#ifndef UART_HANDLER_LIBRARY_H_
#define UART_HANDLER_LIBRARY_H_

#define UART_RX_LINE_BUF_SIZE 256
#define UART_TX_LINE_BUF_SIZE 256

//ENDMARKERS the UART RX ISR is listening on. As soon as one of the ENDMARKERS occurs in
//the received bytes the UART RX ISR feeds the received message into a FIFO.
//IMPORTANT: If no ENDMARKER is found in the RX message, the message wont be forwarded to FIFO!
#ifndef CONFIG_eSIOS_COMMUNICATION || CONFIG_SSI_COMMUNICATION
#define COM_RX_ENDMARKER_1_UART0 '\n'
#define COM_RX_ENDMARKER_2_UART0 '\r'
#endif

#ifdef CONFIG_eSIOS_COMMUNICATION
#define COM_RX_ENDMARKER_1_UART0 0xC0
#define COM_RX_ENDMARKER_2_UART0 0xC0
#endif

#ifdef CONFIG_SSI_COMMUNICATION
#define COM_RX_ENDMARKER_1_UART0 '\n'
#define COM_RX_ENDMARKER_2_UART0 '\r'
#endif

#define COM_RX_ENDMARKER_1_UART1 '\n'
#define COM_RX_ENDMARKER_2_UART1 '\r'

//FIFO struct which helps for UART message transmission.
typedef struct {
	void *fifo_reserved;
	uint8_t data[UART_TX_LINE_BUF_SIZE];
	uint16_t len;
} uart_data_t;

//FIFO struct which stores received UART messages
typedef struct {
	void *fifo_reserved;
	uint8_t *received_line;
	uint8_t len;
} uart_rx_fifo_data_t;

//Struct which helps storing UART_RX data in a FIFO queue.
typedef struct {
	uint8_t uart_rx_buff_len;
	uint8_t uart_rx_buf[UART_RX_LINE_BUF_SIZE];
	bool dirty;
} uart_rx_helper;

/**
 * @brief Sends message via chosen UART port.
 * Single or multiple bytes possible. Maximum message length depends on configured
 * CONFIG_UART_0_NRF_TX_BUFFER_SIZE and CONFIG_UART_1_NRF_TX_BUFFER_SIZE in the prj.conf file (when not specified the standard size of 32 bytes is applied). 
 *
 *
 * @param[in] tx_buf	Byte string of message to be send.     
 * @param[in] msg_len   Length of message to be send.
 * @param[in] uart_dev   UART device which shall send the message.
 *
 * @retval Zero on success, negative otherwise.
 */
int tx_message_uart(char *tx_buf, size_t msg_len,
		    const struct device *uart_dev);

/**
 * @brief Reads message on chosen UART port. 
 *
 *
 * @param[in] rx_buf	Byte string of message to be send.     
 * @param[in] timeout	Maximum waiting period to obtain data.
 * @param[in] uart_dev   UART from which a potential message shall be received.
 *
 * @retval Zero on success, negative otherwise.
 */
int rx_message_uart(uint8_t *rx_buf, k_timeout_t timeout,
		    const struct device *uart_dev);

/**
 * @brief Initialization of chosen UART device. The RX ISR UART receiption will not be initialized
 * using this function call and has to be activated manually.
 * This function supports to initialize the UART devices "UART_0" and "UART_1"
 * 
 * @param[in] uart_num	Name of UART device which shall be initialized.
 *
 * @retval Pointer to initialized UART device, NULL otherwise.
 */
const struct device *init_uart_dev(const char *uart_num);

/**
 * @brief Initialization of chosen UART device and activation of UART RX ISR receiption.
 * This function supports to initialize the UART devices "UART_0" and "UART_1"
 *
 * @param[in] uart_num	Name of UART device which shall be initialized.
 *
 * @retval Pointer to initialized UART device, NULL otherwise.
 */
const struct device *init_uart_dev_and_ISR(const char *uart_num);

#endif /* UART_HANDLER_LIBRARY_H_ */
```

## src/mainMod.c
```c
/*
 * Copyright (c) 2020 Nordic Semiconductor ASA
 *
 * SPDX-License-Identifier: LicenseRef-Nordic-5-Clause
 */

#include <zephyr.h>
#include <stdio.h>
#include <modem/lte_lc.h>
#include <net/socket.h>

#define UDP_IP_HEADER_SIZE 28

static int client_fd;
static struct sockaddr_storage host_addr;
static struct k_work_delayable server_transmission_work;

K_SEM_DEFINE(lte_connected, 0, 1);

static void server_transmission_work_fn(struct k_work *work)
{
	int err;
	char buffer[CONFIG_UDP_DATA_UPLOAD_SIZE_BYTES] = { "\0" };

	printk("Transmitting UDP/IP payload of %d bytes to the ",
	       CONFIG_UDP_DATA_UPLOAD_SIZE_BYTES + UDP_IP_HEADER_SIZE);
	printk("IP address %s, port number %d\n",
	       CONFIG_UDP_SERVER_ADDRESS_STATIC, CONFIG_UDP_SERVER_PORT);

	err = send(client_fd, buffer, sizeof(buffer), 0);
	if (err < 0) {
		printk("Failed to transmit UDP packet, %d\n", errno);
		return;
	}

	k_work_schedule(&server_transmission_work,
			K_SECONDS(CONFIG_UDP_DATA_UPLOAD_FREQUENCY_SECONDS));
}

static void work_init(void)
{
	k_work_init_delayable(&server_transmission_work,
			      server_transmission_work_fn);
}

#if defined(CONFIG_NRF_MODEM_LIB)
static void lte_handler(const struct lte_lc_evt *const evt)
{
	switch (evt->type) {
	case LTE_LC_EVT_NW_REG_STATUS:
		if ((evt->nw_reg_status != LTE_LC_NW_REG_REGISTERED_HOME) &&
		    (evt->nw_reg_status != LTE_LC_NW_REG_REGISTERED_ROAMING)) {
			break;
		}

		printk("Network registration status: %s\n",
		       evt->nw_reg_status == LTE_LC_NW_REG_REGISTERED_HOME ?
				     "Connected - home network" :
				     "Connected - roaming\n");
		k_sem_give(&lte_connected);
		break;
	case LTE_LC_EVT_PSM_UPDATE:
		printk("PSM parameter update: TAU: %d, Active time: %d\n",
		       evt->psm_cfg.tau, evt->psm_cfg.active_time);
		break;
	case LTE_LC_EVT_EDRX_UPDATE: {
		char log_buf[60];
		ssize_t len;

		len = snprintf(log_buf, sizeof(log_buf),
			       "eDRX parameter update: eDRX: %f, PTW: %f\n",
			       evt->edrx_cfg.edrx, evt->edrx_cfg.ptw);
		if (len > 0) {
			printk("%s\n", log_buf);
		}
		break;
	}
	case LTE_LC_EVT_RRC_UPDATE:
		printk("RRC mode: %s\n",
		       evt->rrc_mode == LTE_LC_RRC_MODE_CONNECTED ?
				     "Connected" :
				     "Idle\n");
		break;
	case LTE_LC_EVT_CELL_UPDATE:
		printk("LTE cell changed: Cell ID: %d, Tracking area: %d\n",
		       evt->cell.id, evt->cell.tac);
		break;
	default:
		break;
	}
}

static int configure_low_power(void)
{
	int err;

#if defined(CONFIG_UDP_PSM_ENABLE)
	/** Power Saving Mode */
	err = lte_lc_psm_req(true);
	if (err) {
		printk("lte_lc_psm_req, error: %d\n", err);
	}
#else
	err = lte_lc_psm_req(false);
	if (err) {
		printk("lte_lc_psm_req, error: %d\n", err);
	}
#endif

#if defined(CONFIG_UDP_EDRX_ENABLE)
	/** enhanced Discontinuous Reception */
	err = lte_lc_edrx_req(true);
	if (err) {
		printk("lte_lc_edrx_req, error: %d\n", err);
	}
#else
	err = lte_lc_edrx_req(false);
	if (err) {
		printk("lte_lc_edrx_req, error: %d\n", err);
	}
#endif

#if defined(CONFIG_UDP_RAI_ENABLE)
	/** Release Assistance Indication  */
	err = lte_lc_rai_req(true);
	if (err) {
		printk("lte_lc_rai_req, error: %d\n", err);
	}
#endif

	return err;
}

static void modem_init(void)
{
	int err;

	if (IS_ENABLED(CONFIG_LTE_AUTO_INIT_AND_CONNECT)) {
		/* Do nothing, modem is already configured and LTE connected. */
	} else {
		err = lte_lc_init();
		if (err) {
			printk("Modem initialization failed, error: %d\n", err);
			return;
		}
	}
}

static void modem_connect(void)
{
	int err;

	if (IS_ENABLED(CONFIG_LTE_AUTO_INIT_AND_CONNECT)) {
		/* Do nothing, modem is already configured and LTE connected. */
	} else {
		err = lte_lc_connect_async(lte_handler);
		if (err) {
			printk("Connecting to LTE network failed, error: %d\n",
			       err);
			return;
		}
	}
}
#endif

static void server_disconnect(void)
{
	(void)close(client_fd);
}

static int server_init(void)
{
	struct sockaddr_in *server4 = ((struct sockaddr_in *)&host_addr);

	server4->sin_family = AF_INET;
	server4->sin_port = htons(CONFIG_UDP_SERVER_PORT);

	inet_pton(AF_INET, CONFIG_UDP_SERVER_ADDRESS_STATIC,
		  &server4->sin_addr);

	return 0;
}

static int server_connect(void)
{
	int err;

	client_fd = socket(AF_INET, SOCK_DGRAM, IPPROTO_UDP);
	if (client_fd < 0) {
		printk("Failed to create UDP socket: %d\n", errno);
		err = -errno;
		goto error;
	}

	err = connect(client_fd, (struct sockaddr *)&host_addr,
		      sizeof(struct sockaddr_in));
	if (err < 0) {
		printk("Connect failed : %d\n", errno);
		goto error;
	}

	return 0;

error:
	server_disconnect();

	return err;
}

void main(void)
{
	int err;
	k_msleep(3000);
	printk("UDP sample has started\n");

	work_init();
	printk("after work_init\n");

#if defined(CONFIG_NRF_MODEM_LIB)

	/* Initialize the modem before calling configure_low_power(). This is
	 * because the enabling of RAI is dependent on the
	 * configured network mode which is set during modem initialization.
	 */
	modem_init();

	err = configure_low_power();
	if (err) {
		printk("Unable to set low power configuration, error: %d\n",
		       err);
	}

	modem_connect();
	printk("after modem_connect\n");

	k_sem_take(&lte_connected, K_FOREVER);
	printk("after k_sem_take lte_connected\n");

#endif

	err = server_init();
	if (err) {
		printk("Not able to initialize UDP server connection\n");
		return;
	}

	err = server_connect();
	if (err) {
		printk("Not able to connect to UDP server\n");
		return;
	}

	k_work_schedule(&server_transmission_work, K_NO_WAIT);
}
```

## src/uart.c
```c
#include <zephyr.h>
#include <stdio.h>
#include <drivers/uart.h>
#include <kernel.h>
#include <stdio.h>
#include <string.h>
#include <SEGGER_RTT.h>
#include "UART_handler.h"
#include "uart_entry.h"
#include "udp.h"

void printk_uint8_t(uint8_t *arr, uint8_t len)
{
	for (int i = 0; i < len; i++) {
		printk("%d", arr[i]);
		printk("%s", "-");
	}
	printk("\n");
}

const struct device *uart_div;

uint8_t get_rx_buf_size(uint8_t *rx_buf)
{
	for (int i = 0; i < 256; i++) {
		if ((rx_buf[i] == 102) && (rx_buf[i + 1] == 105) &&
		    (rx_buf[i + 2] == 110) && (rx_buf[i + 3] == 105) &&
		    (rx_buf[i + 4] == 115) && (rx_buf[i + 5] == 104) &&
		    (rx_buf[i + 6] == 49) && (rx_buf[i + 7] == 48) &&
		    (rx_buf[i + 8] == 50)) {
			return i;
		}
	}
	return 0;
}

void uart_entry(void)
{
	// uart handle
	SEGGER_RTT_Init();
	k_msleep(3000);
	printk("uart_entry started \n");
	uart_div = init_uart_dev("UART_0");
	if (!uart_div) {
		printk("Failed to initialize UART Device");
	}

	bool uart_enabled = false;
	int len;
	int err;
	char tx_buf[UART_TX_LINE_BUF_SIZE] = { '\0' };
	uint8_t rx_buf[UART_RX_LINE_BUF_SIZE] = { '\0' };
	while (1) {
		printk("waiting to receive data... \n");
		if (!uart_enabled) {
			uart_enabled = true;
			uart_irq_rx_enable(uart_div);
		}
		//Wait on UART receiption forever...
		len = rx_message_uart(rx_buf, K_FOREVER, uart_div);
		// printk("rx_len %d\n", len);
		if (len <= 0) {
			printk("Failed UART RX Receiption\n");
		} else {
			printk("data recived: %s", rx_buf);
			//Notify D9x11 tEhat message was received
			if (server_connected && modem_status) {
				snprintf(tx_buf, UART_TX_LINE_BUF_SIZE,
					 "ACK\n");
			} else {
				snprintf(tx_buf, UART_TX_LINE_BUF_SIZE,
					 "WAITING_FOR_CONNECTION\n");
			}
			err = tx_message_uart(tx_buf, strlen(tx_buf), uart_div);
			if (err < 0) {
				printk("FAILED UART TX\n");
			}
			memset(tx_buf, 0, sizeof(tx_buf));
			//Print message for debug purposes
			printk("rx_buf:%s :\n", rx_buf);
			len = get_rx_buf_size(rx_buf);
			// printk("rx_len calc %d\n", len);
			data.size = len;
			memcpy(data.buff, rx_buf, len);

			data.state = DATA_PENDING;
			memset(rx_buf, 0, sizeof(rx_buf));
			// printk_uint8_t(data.buff, data.size);
		}
	}
}

K_THREAD_DEFINE(uart_entry_id, STACKSIZE, uart_entry, NULL, NULL, NULL, 2, 0,
		0);
```

## src/uart_entry.h
```c
#ifndef UART_ENTRY_H_
#define UART_ENTRY_H_

#define STACKSIZE 2048



#endif
```

## src/udp.c
```c
/*
 * Copyright (c) 2020 Nordic Semiconductor ASA
 *
 * SPDX-License-Identifier: LicenseRef-Nordic-5-Clause
 */
#include <zephyr.h>
#include <kernel.h>
#include <modem/lte_lc.h>
#include <net/socket.h>
#include <modem/modem_info.h>
#include <modem/at_params.h>
#include <modem/at_cmd.h>
#include <cJSON.h>
#include <cJSON_os.h>
#include <stdio.h>
#include <SEGGER_RTT.h>
#include <net/socket.h>
#include <stdio.h>
#include <zephyr.h>
#include <string.h>
#include <drivers/uart.h>
#include <udp.h>

static int client_fd;
static struct sockaddr_storage host_addr;
static struct k_work_delayable server_transmission_work;

uint8_t server_connected = SERV_PENDING;
uint8_t modem_status = MODEM_PENDING;
// struct Data data = { .buff = "COLL_test123",
// 		     .state = DATA_PENDING,
// 		     .size = 12 };
struct Data data = {
	.buff = { 10,  104, 10,	 32,  8,   0,	18,  9,	  13,  0,   192, 45,
		  197, 16,  0,	 24,  2,   24,	215, 218, 155, 143, 6,	 34,
		  3,   99,  104, 52,  40,  3,	50,  4,	  8,   0,   16,	 0,
		  10,  33,  8,	 2,   18,  9,	13,  0,	  128, 228, 196, 16,
		  0,   24,  2,	 24,  215, 218, 155, 143, 6,   34,  4,	 99,
		  104, 52,  43,	 40,  3,   50,	4,   8,	  0,   16,  0,	 10,
		  31,  8,   4,	 18,  9,   13,	0,   0,	  0,   0,   16,	 1,
		  24,  2,   24,	 215, 218, 155, 143, 6,	  34,  2,   67,	 79,
		  40,  3,   50,	 4,   8,   0,	16,  0,	  16,  0 },
	.state = DATA_PENDING,
	.size = 106
};

K_SEM_DEFINE(lte_connected, 0, 1);

static void server_transmission_work_fn(struct k_work *work)
{
	int err;
	// printk("sending data:\n");
	// char buffer[CONFIG_UDP_DATA_UPLOAD_SIZE_BYTES] = { "testing123" };
	if (data.state == DATA_PENDING) {
		printk("Transmitting UDP/IP payload of %d bytes to the \n",
		       CONFIG_UDP_DATA_UPLOAD_SIZE_BYTES + UDP_IP_HEADER_SIZE);
		// printk("IP address %s, port number %d\n",
		//        CONFIG_UDP_SERVER_ADDRESS_STATIC,
		//        CONFIG_UDP_SERVER_PORT);

		// err = send(client_fd, data.buff, sizeof(data.buff), 0);
		err = send(client_fd, data.buff, data.size, 0);
		if (err < 0) {
			printk("Failed to transmit UDP packet, %d\n", errno);
			return;
		}

		// data.state = DATA_SENT;
	}
	// K_SECONDS(CONFIG_UDP_DATA_UPLOAD_FREQUENCY_SECONDS);
	// k_work_schedule(&server_transmission_work, K_MSEC(10));
	k_work_schedule(&server_transmission_work, K_MSEC(10000));

	// k_work_schedule(&server_transmission_work, K_NO_WAIT);
}

static void work_init(void)
{
	k_work_init_delayable(&server_transmission_work,
			      server_transmission_work_fn);
}

#if defined(CONFIG_NRF_MODEM_LIB)
static void lte_handler(const struct lte_lc_evt *const evt)
{
	// printk("from lte_handler \n");
	switch (evt->type) {
	case LTE_LC_EVT_NW_REG_STATUS:

		if ((evt->nw_reg_status != LTE_LC_NW_REG_REGISTERED_HOME) &&
		    (evt->nw_reg_status != LTE_LC_NW_REG_REGISTERED_ROAMING)) {
			if (evt->nw_reg_status == LTE_LC_NW_REG_UICC_FAIL) {
				printk("No SIM card detected!\n");
			}
			break;
		}

		printk("Network registration status: %s\n",
		       evt->nw_reg_status == LTE_LC_NW_REG_REGISTERED_HOME ?
				     "Connected - home network" :
				     "Connected - roaming\n");

		k_sem_give(&lte_connected);
		break;
	case LTE_LC_EVT_PSM_UPDATE:
		printk("PSM parameter update: TAU: %d, Active time: %d\n",
		       evt->psm_cfg.tau, evt->psm_cfg.active_time);
		break;
	case LTE_LC_EVT_EDRX_UPDATE: {
		// printk("3.case \n");
		char log_buf[60];
		ssize_t len;

		len = snprintf(log_buf, sizeof(log_buf),
			       "eDRX parameter update: eDRX: %f, PTW: %f\n",
			       evt->edrx_cfg.edrx, evt->edrx_cfg.ptw);
		if (len > 0) {
			printk("%s\n", log_buf);
		}
		break;
	}
	case LTE_LC_EVT_RRC_UPDATE:
		printk("RRC mode: %s\n",
		       evt->rrc_mode == LTE_LC_RRC_MODE_CONNECTED ?
				     "Connected" :
				     "Idle\n");
		break;
	case LTE_LC_EVT_CELL_UPDATE:
		printk("LTE cell changed: Cell ID: %d, Tracking area: %d\n",
		       evt->cell.id, evt->cell.tac);
		if (evt->cell.id == -1) {
			modem_status = MODEM_PENDING;
		} else {
			modem_status = MODEM_CONNECTED;
		}
		break;
	default:
		// printk("default case \n");
		break;
	}
}

static int configure_low_power(void)
{
	int err;

#if defined(CONFIG_UDP_PSM_ENABLE)
	/** Power Saving Mode */
	err = lte_lc_psm_req(true);
	if (err) {
		printk("lte_lc_psm_req, error: %d\n", err);
	}
#else
	err = lte_lc_psm_req(false);
	if (err) {
		printk("lte_lc_psm_req, error: %d\n", err);
	}
#endif

#if defined(CONFIG_UDP_EDRX_ENABLE)
	/** enhanced Discontinuous Reception */
	err = lte_lc_edrx_req(true);
	if (err) {
		printk("lte_lc_edrx_req, error: %d\n", err);
	}
#else
	err = lte_lc_edrx_req(false);
	if (err) {
		printk("lte_lc_edrx_req, error: %d\n", err);
	}
#endif

#if defined(CONFIG_UDP_RAI_ENABLE)
	/** Release Assistance Indication  */
	err = lte_lc_rai_req(true);
	if (err) {
		printk("lte_lc_rai_req, error: %d\n", err);
	}
#endif

	return err;
}

static void modem_init(void)
{
	int err;

	if (IS_ENABLED(CONFIG_LTE_AUTO_INIT_AND_CONNECT)) {
		/* Do nothing, modem is already configured and LTE connected. */
	} else {
		err = lte_lc_init();
		if (err) {
			printk("Modem initialization failed, error: %d\n", err);
			return;
		}
	}
}

static void modem_connect(void)
{
	int err;

	if (IS_ENABLED(CONFIG_LTE_AUTO_INIT_AND_CONNECT)) {
		/* Do nothing, modem is already configured and LTE connected. */
	} else {
		err = lte_lc_connect_async(lte_handler);
		printk("Connecting to LTE network, error: %d\n", err);
		if (err) {
			printk("Connecting to LTE network failed, error: %d\n",
			       err);
			return;
		}
	}
}
#endif

static void server_disconnect(void)
{
	(void)close(client_fd);
}

static int server_init(void)
{
	struct sockaddr_in *server4 = ((struct sockaddr_in *)&host_addr);

	server4->sin_family = AF_INET;
	server4->sin_port = htons(CONFIG_UDP_SERVER_PORT);

	inet_pton(AF_INET, CONFIG_UDP_SERVER_ADDRESS_STATIC,
		  &server4->sin_addr);

	return 0;
}

static int server_connect(void)
{
	int err;

	client_fd = socket(AF_INET, SOCK_DGRAM, IPPROTO_UDP);
	if (client_fd < 0) {
		printk("Failed to create UDP socket: %d\n", errno);
		err = -errno;
		goto error;
	}

	err = connect(client_fd, (struct sockaddr *)&host_addr,
		      sizeof(struct sockaddr_in));
	if (err < 0) {
		printk("Connect failed : %d\n", errno);
		goto error;
	}

	return 0;

error:
	server_disconnect();

	return err;
}

void udp_entry()
{
	int err;

	SEGGER_RTT_Init();
	printk("UDP has started\n");
	work_init();
	// printk("after work_init\n");
#if defined(CONFIG_NRF_MODEM_LIB)

	/* Initialize the modem before calling configure_low_power(). This is
   * because the enabling of RAI is dependent on the
   * configured network mode which is set during modem initialization.
   */
	modem_init();

	err = configure_low_power();
	if (err) {
		printk("Unable to set low power configuration, error: %d\n",
		       err);
	}
	printk(" modem_low_power configured!\n");
	modem_connect();
	printk(" starting modem connection ...\n");
	k_sem_take(&lte_connected, K_FOREVER);
	modem_status = MODEM_CONNECTED;
	printk("lte_connected!\n");
#endif

	err = server_init();

	if (err) {
		printk("Not able to initialize UDP server connection\n");
		return;
	}

	err = server_connect();
	if (err) {
		printk("Not able to connect to UDP server\n");
		return;
	}
	server_connected = SERV_CONNECTED;
	k_work_schedule(&server_transmission_work, K_NO_WAIT);
}

// K_THREAD_DEFINE(udp_id, STACKSIZE, udp, NULL, NULL, NULL, 3, 0, 0);

// K_THREAD_STACK_DEFINE(_k_thread_stack_udp, STACKSIZE);

// struct k_thread udp_thread;
// k_tid_t my_tid = k_thread_create(&udp_thread, _k_thread_stack_udp, STACKSIZE,
// 				 udp_entry, NULL, NULL, NULL, 3, 0, K_NO_WAIT);
static K_THREAD_STACK_DEFINE(udp_stack_area, STACKSIZE);
static struct k_thread udp_thread_data;
k_tid_t udp_t_id;
int start_udp_thread(void)
{
	udp_t_id =
		k_thread_create(&udp_thread_data, udp_stack_area,
				K_THREAD_STACK_SIZEOF(udp_stack_area),
				udp_entry, NULL, NULL, NULL, 3, 0, K_NO_WAIT);

	return 0;
}

int main()
{
	uint32_t current_time = k_uptime_get_32();
	start_udp_thread();
	uint32_t start_time = k_uptime_get_32();
	while (1) {
		while (modem_status == MODEM_PENDING ||
		       server_connected == SERV_PENDING) {
			k_msleep(20000); //wait another 20 sec
			current_time = k_uptime_get_32();
			if (current_time - start_time >
			    MODEM_MAX_WAIT_TIME_MS) {
				printk("\n\n-------------------------\n");
				printk("restarting upd_entry \n");
				printk("\n\n-------------------------\n");
				k_thread_abort(&udp_thread_data);
				k_msleep(3000);
				start_udp_thread();
				start_time = k_uptime_get_32();
			}
		}
		//check after a while if modem is still connected
		k_msleep(MODEM_FREQUENT_CHECK_TIME_MS);
	}
}
```

## src/udp.h
```c
#ifndef UDP_SEND_H_
#define UDP_SEND_H_

#define STACKSIZE 2048
#define UDP_IP_HEADER_SIZE 28
#define DATA_PENDING 0
#define DATA_SENT 1

#define MODEM_CONNECTED 1
#define MODEM_PENDING 0
#define MODEM_MAX_WAIT_TIME_MS 90000
#define MODEM_FREQUENT_CHECK_TIME_MS 15000
#define SERV_CONNECTED 1
#define SERV_PENDING 0

typedef struct Data {
	uint8_t buff[CONFIG_UDP_DATA_UPLOAD_SIZE_BYTES];
	uint8_t state;
	uint8_t size;
} Data;
extern struct Data data;
extern uint8_t server_connected;
extern uint8_t modem_status;

int start_udp_thread(void);

#endif
```
